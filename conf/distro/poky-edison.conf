## conf/distro/poky-edison.conf
```bitbake
require conf/distro/poky.conf
DISTRO = "poky-edison"

PREFERRED_PROVIDER_virtual/kernel ?= "linux-yocto"
PREFERRED_VERSION_linux-yocto = "3.14%"
PREFERRED_PROVIDER_virtual/bootloader ?= "u-boot"
PREFERRED_VERSION_u-boot = "2014.04-1"
PREFERRED_VERSION_u-boot-fw-utils = "2014.04-1"
```

## conf/layer.conf
```bitbake
# We have a conf and classes directory, add to BBPATH
BBPATH .= ":${LAYERDIR}"

# We have a recipes-* directories, add to BBFILES
BBFILES += "${LAYERDIR}/recipes-*/*/*.bb ${LAYERDIR}/recipes-*/*/*.bbappend"

BBFILE_COLLECTIONS += "edison"
BBFILE_PATTERN_edison = "^${LAYERDIR}/"
BBFILE_PRIORITY_edison = "6"
LAYERVERSION_edison = "1"
```

## conf/machine/edison.conf
```bitbake
#@TYPE: Machine
#@NAME: Edison

#@DESCRIPTION: Machine configuration for edison systems.

include conf/machine/include/tune-atom.inc

MACHIN_FEATURES = "bluetooth pci serial usbgadget usbhost wifi x86 ext3"
KERNEL_IMAGETYPE = "bzImage"
SERIAL_CONSOLES = "115200;ttyMFD2"
UBOOT_MACHINE = "edison_config"
```
